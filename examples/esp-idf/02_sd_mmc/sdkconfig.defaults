## examples/esp-idf/02_sd_mmc/sdkconfig.defaults
```kconfig
CONFIG_IDF_TARGET="esp32s3"
CONFIG_ESPTOOLPY_FLASHSIZE_16MB=y

CONFIG_FATFS_VFS_FSTAT_BLKSIZE=4096
CONFIG_ESP_CONSOLE_USB_SERIAL_JTAG=y

# Shared product component features
# CONFIG_WS_BOARD_DISPLAY is not set
# CONFIG_WS_BOARD_AUDIO is not set
# CONFIG_I2C_BUS_BACKWARD_CONFIG is not set
```

## examples/esp-idf/09_lora_ping_pong/sdkconfig.defaults
```kconfig
# Increase FreeRTOS tick rate to 1000 Hz
CONFIG_IDF_TARGET="esp32s3"
CONFIG_ESPTOOLPY_FLASHSIZE_16MB=y

CONFIG_FREERTOS_HZ=1000

CONFIG_ESP_CONSOLE_USB_SERIAL_JTAG=y

# Shared product component features
# CONFIG_WS_BOARD_DISPLAY is not set
# CONFIG_WS_BOARD_AUDIO is not set
# CONFIG_I2C_BUS_BACKWARD_CONFIG is not set
```
